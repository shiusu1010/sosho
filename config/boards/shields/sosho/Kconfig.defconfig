## config/boards/shields/sosho/Kconfig.defconfig
```kconfig
if SHIELD_SOSHO_R_TRACKPAD || SHIELD_SOSHO_R_TRACKBALL

config ZMK_KEYBOARD_NAME
    default "sosho"

config ZMK_SPLIT
    default y

config ZMK_SPLIT_ROLE_CENTRAL
    default y

config ZMK_POINTING
    default y

config SPI
    default y

endif

if SHIELD_SOSHO_L_TRACKPAD || SHIELD_SOSHO_L_TRACKBALL

config ZMK_KEYBOARD_NAME
    default "sosho"

config ZMK_SPLIT
    default y

config INPUT
    default y

config ZMK_POINTING
    default y

config SPI
    default y

endif

if SHIELD_SOSHO_DONGLE

config ZMK_KEYBOARD_NAME
    default "SOSHO Dongle"

config ZMK_SPLIT_ROLE_CENTRAL
    default y

config ZMK_SPLIT
    default y

# 左右分割の2つ（左手・右手）を子機として繋ぐ設定
config ZMK_SPLIT_BLE_CENTRAL_PERIPHERALS
    default 2

endif
```

## config/west.yml
```yaml
manifest:
  defaults:
    revision: main
  remotes:
    - name: zmkfirmware
      url-base: https://github.com/zmkfirmware
    - name: caksoylar
      url-base: https://github.com/caksoylar
    - name: carrefinho
      url-base: https://github.com/carrefinho
  projects:
    - name: zmk
      remote: zmkfirmware
      revision: main
      import: app/west.yml
    - name: zmk-rgbled-widget
      remote: caksoylar
      revision: main
    - name: prospector-zmk-module
      remote: carrefinho
      # ▼ 最新ZMK(Zephyr 4.1)に対応した専用ブランチへと切り替えます！
      revision: feat/new-status-screens
  self:
    path: config
```
