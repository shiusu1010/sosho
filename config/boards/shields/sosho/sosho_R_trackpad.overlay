#include "sosho_R.dtsi"

&spi0 {
    status = "disabled"; // 変更：SPI通信（通信線）の電源を完全にオフ
};

&glidepoint {
    status = "disabled"; // 変更：トラックパッド自体の電源を完全にオフ
    invert-y;
};

&glidepoint_split {
    status = "disabled"; // 変更：ドングルへポインタ情報を送る中継ノードをオフ
    device = <&glidepoint>;
};